## NRF52840/led_pwm/build/Kconfig/Kconfig.shield
```kconfig
osource "c:/Users/eidos/Desktop/NRF52840/led_pwm/boards/shields/*/Kconfig.shield"
osource "C:/Users/eidos/ncs/v1.9.1/nrf/boards/shields/*/Kconfig.shield"
```
